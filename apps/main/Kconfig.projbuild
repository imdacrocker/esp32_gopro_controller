## apps/main/Kconfig.projbuild
```kconfig
menu "GoPro Controller — OTA"

    config OTA_BASE_URL
        string "Cloudflare Worker base URL (proxy to GitHub Releases)"
        default "https://firmware-proxy.imdacrocker.workers.dev"
        help
            Base URL the browser uses to fetch manifests and binaries.
            The Worker proxies github.com and adds CORS headers.
            Path layout: <base>/<owner>/<repo>/releases/download/latest-<channel>/manifest.json
            See ota_design.md §5 (Manifest format) and Appendix A (Worker source).
            Replace the default with your deployed Worker URL.

    config OTA_ALLOW_DEV_CHANNEL
        bool "Expose 'dev' channel in /api/ota/channel"
        default n
        help
            When enabled, adds "dev" to the available-channels list returned by
            GET /api/ota/channel. Intended for local developer builds only —
            no online publishing target exists for the dev channel.

endmenu
```

## apps/main/main/Kconfig.projbuild
```kconfig
menu "GoPro Controller — Identity"

    config DEVICE_IDENTITY_NAME
        string "Controller identity name"
        default "ESP32 Controller"
        help
            Single source of truth for the controller's display name. Used as:
              - NimBLE GAP device name (BLE adverts and connections)
              - GoPro RequestPairingFinish phone_name protobuf field
              - GoPro legacy wireless/pair/complete `deviceName` URL parameter
            Keep it short ASCII — it ends up on the camera UI and in URLs.

endmenu

menu "GoPro Controller — OTA"

    config OTA_BASE_URL
        string "Cloudflare Worker base URL (proxy to GitHub Releases)"
        default "https://firmware-proxy.imdacrocker.workers.dev"
        help
            Base URL the browser uses to fetch manifests and binaries.
            The Worker proxies github.com and adds CORS headers.
            Path layout: <base>/<owner>/<repo>/releases/download/latest-<channel>/manifest.json
            See docs/design/ota.md §5 (Manifest format) and Appendix A (Worker source).
            Replace the default with your deployed Worker URL.

    config OTA_REPO_PATH
        string "GitHub <owner>/<repo> path for releases"
        default "imdacrocker/esp32_gopro_controller"
        help
            Used by the browser to compose the full manifest URL:
              <OTA_BASE_URL>/<OTA_REPO_PATH>/releases/download/latest-<channel>/manifest.json
            Change this if you fork the project.

    config OTA_ALLOW_DEV_CHANNEL
        bool "Expose 'dev' channel in /api/ota/channel"
        default n
        help
            When enabled, adds "dev" to the available-channels list returned by
            GET /api/ota/channel. Intended for local developer builds only —
            no online publishing target exists for the dev channel.

endmenu
```

## apps/recovery/main/Kconfig.projbuild
```kconfig
menu "GoPro Controller — Product (recovery)"

    config PRODUCT_VARIANT
        string "Product variant slug"
        default "wireless"
        help
            Build-time identifier for the product variant this recovery
            image belongs to (see docs/multi-variant-restructure-plan.md).
            Must match the variant of the paired main app — they ship as a
            unit per release. Threaded through:
              - /api/version's `product` field (read by the recovery UI
                to compose the variant-aware OTA route)
              - per-variant OTA floating tags
                (latest-<channel>-<PRODUCT_VARIANT>)

            Keep it short ASCII, no slashes — it ends up in URLs.

endmenu

menu "GoPro Controller — OTA (recovery)"

    config OTA_BASE_URL
        string "Cloudflare Worker base URL (proxy to GitHub Releases)"
        default "https://firmware-proxy.imdacrocker.workers.dev"
        help
            Base URL the embedded recovery UI uses to fetch manifests and
            binaries. Must match apps/wireless/Kconfig.projbuild — both apps
            ship as a pair with the same default. If the URL ever moves,
            users on stale recovery builds fall back to manual upload
            (per docs/design/ota.md §1).

    config OTA_REPO_PATH
        string "GitHub <owner>/<repo> path for releases"
        default "imdacrocker/esp32_gopro_controller"
        help
            Used by the recovery UI to compose the full manifest URL:
              <OTA_BASE_URL>/<OTA_REPO_PATH>/releases/download/latest-<channel>/manifest.json

    config OTA_ALLOW_DEV_CHANNEL
        bool "Expose 'dev' channel in /api/ota/channel"
        default n
        help
            When enabled, adds "dev" to the available-channels list returned
            by GET /api/ota/channel. No online publishing target exists for
            the dev channel — local-only.

endmenu
```

## apps/recovery/sdkconfig.defaults
```kconfig
CONFIG_IDF_TARGET="esp32s3"
CONFIG_ESPTOOLPY_FLASHSIZE_8MB=y
CONFIG_ESPTOOLPY_FLASHSIZE="8MB"

# Share the partition table with the main app (lives at the monorepo root).
CONFIG_PARTITION_TABLE_CUSTOM=y
CONFIG_PARTITION_TABLE_CUSTOM_FILENAME="../../partitions.csv"

# Recovery image lands in the `factory` slot — bootloader rollback semantics
# only matter for the OTA slots, but we keep this enabled so the recovery's
# bootloader (if ever the one running) behaves identically to main's.
CONFIG_BOOTLOADER_APP_ROLLBACK_ENABLE=y

# Reported via /api/version. Bump in lockstep with breaking upload-protocol
# changes (manifest's `min_recovery_version`, see docs/design/ota.md §5).
CONFIG_APP_PROJECT_VER_FROM_CONFIG=y
CONFIG_APP_PROJECT_VER="1.0.1"

# DHCP server for SoftAP clients
CONFIG_LWIP_DHCPS=y
CONFIG_LWIP_DHCPS_MAX_STATION_NUM=8

# Socket budget: httpd (8) + httpd internal (3) + headroom = 12
CONFIG_LWIP_MAX_SOCKETS=12

# tcpip_thread stack — match the main project so httpd behavior is identical
CONFIG_LWIP_TCPIP_TASK_STACK_SIZE=5120

# Required for X-Sha256 + X-Size custom headers on upload requests
CONFIG_HTTPD_MAX_REQ_HDR_LEN=1024

# Pin esp_timer to core 0 alongside WiFi for parity with main
CONFIG_ESP_TIMER_TASK_AFFINITY_CPU0=y
CONFIG_ESP_TIMER_TASK_STACK_SIZE=4096

CONFIG_LOG_DEFAULT_LEVEL_INFO=y
CONFIG_LOG_MAXIMUM_LEVEL_INFO=y
CONFIG_LOG_TIMESTAMP_SOURCE_RTOS=y

# ---- Size budget: recovery image must fit in the 512 KB factory partition ----
#
# Optimize for size, not debug ergonomics.
CONFIG_COMPILER_OPTIMIZATION_SIZE=y

# Smaller printf (drops floating-point + %a + some width handling); saves ~50 KB
# on libesp_stdio. Recovery only logs simple integers / strings.
CONFIG_NEWLIB_NANO_FORMAT=y

# WiFi runs in OPEN auth mode (see wifi_manager.c). No WPA/WPA2/Enterprise.
CONFIG_ESP_WIFI_ENABLE_WPA3_SAE=n
CONFIG_ESP_WIFI_WPS_SOFTAP_REGISTRAR=n
CONFIG_ESP_WIFI_ENABLE_WAPI_PSK=n
CONFIG_ESP_WIFI_MBEDTLS_TLS_CLIENT=n
CONFIG_ESP_WIFI_ENTERPRISE_SUPPORT=n
CONFIG_ESP_WIFI_SUITE_B_192=n

# mbedtls: drop deprecated/legacy crypto modules. Keep TLS/X509 enabled
# because tcp_transport/esp-tls compile against them even though recovery
# doesn't use TLS — it's cheaper to ship those than to surgically exclude them.
CONFIG_MBEDTLS_CERTIFICATE_BUNDLE=n
CONFIG_MBEDTLS_PEM_PARSE_C=n
CONFIG_MBEDTLS_PEM_WRITE_C=n
CONFIG_MBEDTLS_RIPEMD160_C=n
CONFIG_MBEDTLS_HAVE_TIME=n
CONFIG_MBEDTLS_HAVE_TIME_DATE=n

# httpd: drop WebSocket support and oversized defaults.
CONFIG_HTTPD_WS_SUPPORT=n

# Expose the "dev" channel in the recovery UI dropdown. Dev builds are
# recovery-only — the main app's equivalent flag stays off so dev never
# appears in its settings dropdown (see apps/main/Kconfig.projbuild).
CONFIG_OTA_ALLOW_DEV_CHANNEL=y

## SOFTAP / LOCAL NETWORK
# Must match apps/main/sdkconfig.defaults so a browser left on the local domain
# resolves identically whether the main app or recovery is running. Uncomment to
# override the Kconfig defaults shown.
#CONFIG_WIFI_AP_IP_ADDR="10.71.79.1"
#CONFIG_WIFI_LOCAL_DOMAIN="control.gp"
```

## apps/wired/sdkconfig.defaults
```kconfig
CONFIG_IDF_TARGET="esp32s3"
CONFIG_ESPTOOLPY_FLASHSIZE_8MB=y
CONFIG_ESPTOOLPY_FLASHSIZE="8MB"
CONFIG_PARTITION_TABLE_CUSTOM=y
CONFIG_PARTITION_TABLE_CUSTOM_FILENAME="../../partitions.csv"

# CherryUSB
CONFIG_CHERRYUSB=y
CONFIG_CHERRYUSB_HOST=y
CONFIG_CHERRYUSB_HOST_DWC2_ESP=y
CONFIG_CHERRYUSB_HOST_CDC_NCM=y
CONFIG_CHERRYUSB_HOST_CDC_RNDIS=y

# OTA: app rollback + project version reported via esp_app_get_description()
CONFIG_BOOTLOADER_APP_ROLLBACK_ENABLE=y
CONFIG_APP_PROJECT_VER_FROM_CONFIG=y
CONFIG_APP_PROJECT_VER="0.1.1-dev"

# DHCP server
CONFIG_LWIP_DHCPS=y
CONFIG_LWIP_DHCPS_MAX_STATION_NUM=8

# Socket budget: 8 (httpd) + 3 (httpd internal) + 2 (gopro_rc UDP) + 4 (COHN TLS) = 17
CONFIG_LWIP_MAX_SOCKETS=17

# tcpip_thread stack — default 3072 is too shallow under concurrent httpd+BLE load
# CONFIG_LWIP_TCPIP_TASK_STACK_SIZE=5120 # Not needed with no BLE?

# Web UI server
CONFIG_HTTPD_MAX_REQ_HDR_LEN=1024

#CONFIG_LITTLEFS_PARTITION_LABEL="storage" 

# Pin esp_timer task to core 0 alongside WiFi (§4.1)
CONFIG_ESP_TIMER_TASK_AFFINITY_CPU0=y
CONFIG_ESP_TIMER_TASK_STACK_SIZE=4096

CONFIG_LOG_DEFAULT_LEVEL_INFO=y       # production-quiet at boot
CONFIG_LOG_MAXIMUM_LEVEL_VERBOSE=y    # ceiling for runtime override (§22.6)
CONFIG_LOG_TIMESTAMP_SOURCE_RTOS=y
CONFIG_LOG_COLORS=y                   # ANSI colors over USB serial

# Diagnostic log ring buffer (docs/design/log-capture.md).
# Kept at 64 KB because 128 KB starved the heap (largest contiguous block
# dropped to ~7.7 KB, smaller than the smallest web UI file). To enlarge,
# move the ring to PSRAM rather than growing static DRAM. See §10 of
# docs/design/log-capture.md.
CONFIG_LOG_RING_SIZE_KB=64

## POWER SETTINGS
# Decrease brownout sensitivity from 7 to 5
#CONFIG_ESP_BROWNOUT_DET_LVL_SEL_5=y
#CONFIG_ESP_BROWNOUT_DET_LVL=5

# Increase the CPU clock
#CONFIG_ESP_DEFAULT_CPU_FREQ_MHZ_240=y
#CONFIG_ESP_DEFAULT_CPU_FREQ_MHZ=240

#CONFIG_ESP_WIFI_RX_IRAM_OPT=y
#CONFIG_TWAI_ISR_IN_IRAM=y
```

## apps/wireless/components/log_ring/Kconfig
```kconfig
menu "Log Ring"

config LOG_RING_SIZE_KB
    int "Ring buffer size (KB)"
    default 64
    range 8 256
    help
        Size of the in-RAM log ring buffer. Consumes static (.bss) memory.
        Larger values capture more history at the cost of internal SRAM.

endmenu
```

## apps/wireless/main/Kconfig.projbuild
```kconfig
menu "GoPro Controller — Identity"

    config DEVICE_IDENTITY_NAME
        string "Controller identity name"
        default "ESP32 Controller"
        help
            Single source of truth for the controller's display name. Used as:
              - NimBLE GAP device name (BLE adverts and connections)
              - GoPro RequestPairingFinish phone_name protobuf field
              - GoPro legacy wireless/pair/complete `deviceName` URL parameter
            Keep it short ASCII — it ends up on the camera UI and in URLs.

endmenu

menu "GoPro Controller — Product"

    config PRODUCT_VARIANT
        string "Product variant slug"
        default "wireless"
        help
            Build-time identifier for the product variant this firmware
            belongs to (see docs/multi-variant-restructure-plan.md). Today
            the only shipping variant is "wireless"; future siblings
            (e.g. a wired/USB controller) drop their own Kconfig default
            into their app tree.

            Threaded through:
              - /api/version's `product` field (read by the web UI to
                compose the variant-aware OTA route)
              - per-variant OTA floating tags
                (latest-<channel>-<PRODUCT_VARIANT>)
              - launchpad firmware-images URL

            Keep it short ASCII, no slashes — it ends up in URLs.

endmenu

menu "GoPro Controller — OTA"

    config OTA_BASE_URL
        string "Cloudflare Worker base URL (proxy to GitHub Releases)"
        default "https://firmware-proxy.imdacrocker.workers.dev"
        help
            Base URL the browser uses to fetch manifests and binaries.
            The Worker proxies github.com and adds CORS headers.
            Path layout: <base>/<owner>/<repo>/releases/download/latest-<channel>/manifest.json
            See docs/design/ota.md §5 (Manifest format) and Appendix A (Worker source).
            Replace the default with your deployed Worker URL.

    config OTA_REPO_PATH
        string "GitHub <owner>/<repo> path for releases"
        default "imdacrocker/esp32_gopro_controller"
        help
            Used by the browser to compose the full manifest URL:
              <OTA_BASE_URL>/<OTA_REPO_PATH>/releases/download/latest-<channel>/manifest.json
            Change this if you fork the project.

    config OTA_ALLOW_DEV_CHANNEL
        bool "Expose 'dev' channel in /api/ota/channel"
        default n
        help
            When enabled, adds "dev" to the available-channels list returned by
            GET /api/ota/channel. Intended for local developer builds only —
            no online publishing target exists for the dev channel.

endmenu
```

## apps/wireless/sdkconfig.defaults
```kconfig
CONFIG_IDF_TARGET="esp32s3"
CONFIG_ESPTOOLPY_FLASHSIZE_8MB=y
CONFIG_ESPTOOLPY_FLASHSIZE="8MB"
CONFIG_PARTITION_TABLE_CUSTOM=y
CONFIG_PARTITION_TABLE_CUSTOM_FILENAME="../../partitions.csv"

# OTA: app rollback + project version reported via esp_app_get_description()
CONFIG_BOOTLOADER_APP_ROLLBACK_ENABLE=y
CONFIG_APP_PROJECT_VER_FROM_CONFIG=y
CONFIG_APP_PROJECT_VER="0.1.1-dev"

CONFIG_BT_ENABLED=y
CONFIG_BT_NIMBLE_ENABLED=y
CONFIG_BT_CONTROLLER_ENABLED=y
CONFIG_BT_NIMBLE_LOG_LEVEL_WARNING=y

# Pin NimBLE host and BT controller to core 1 (§4.1)
CONFIG_BT_NIMBLE_PINNED_TO_CORE_1=y
CONFIG_BT_CTRL_PINNED_TO_CORE_1=y

# Connection capacity: 4 cameras + headroom
CONFIG_BT_NIMBLE_MAX_CONNECTIONS=5

# Bonding storage in NVS
CONFIG_BT_NIMBLE_NVS_PERSIST=y

# ATT MTU — request the maximum so GoPro long responses
# (GetHardwareInfoRsp ~88 bytes) do not fragment
CONFIG_BT_NIMBLE_ATT_PREFERRED_MTU=517

# Pin WiFi task to core 0, opposite NimBLE (§4.1)
CONFIG_ESP_WIFI_TASK_PINNED_TO_CORE_0=y

# DHCP server
CONFIG_LWIP_DHCPS=y
CONFIG_LWIP_DHCPS_MAX_STATION_NUM=8

# Socket budget: 8 (httpd) + 3 (httpd internal) + 2 (gopro_rc UDP) + 4 (COHN TLS) = 17
CONFIG_LWIP_MAX_SOCKETS=17

# tcpip_thread stack — default 3072 is too shallow under concurrent httpd+BLE load
CONFIG_LWIP_TCPIP_TASK_STACK_SIZE=5120

# Web UI server
CONFIG_HTTPD_MAX_REQ_HDR_LEN=1024

#CONFIG_LITTLEFS_PARTITION_LABEL="storage" 

# Pin esp_timer task to core 0 alongside WiFi (§4.1)
CONFIG_ESP_TIMER_TASK_AFFINITY_CPU0=y
CONFIG_ESP_TIMER_TASK_STACK_SIZE=4096

CONFIG_LOG_DEFAULT_LEVEL_INFO=y       # production-quiet at boot
CONFIG_LOG_MAXIMUM_LEVEL_VERBOSE=y    # ceiling for runtime override (§22.6)
CONFIG_LOG_TIMESTAMP_SOURCE_RTOS=y
CONFIG_LOG_COLORS=y                   # ANSI colors over USB serial

# Diagnostic log ring buffer (docs/design/log-capture.md).
# Kept at 64 KB because 128 KB starved the heap (largest contiguous block
# dropped to ~7.7 KB, smaller than the smallest web UI file). To enlarge,
# move the ring to PSRAM rather than growing static DRAM. See §10 of
# docs/design/log-capture.md.
CONFIG_LOG_RING_SIZE_KB=64

## POWER SETTINGS
# Decrease brownout sensitivity from 7 to 5
#CONFIG_ESP_BROWNOUT_DET_LVL_SEL_5=y
#CONFIG_ESP_BROWNOUT_DET_LVL=5

# Increase the CPU clock
#CONFIG_ESP_DEFAULT_CPU_FREQ_MHZ_240=y
#CONFIG_ESP_DEFAULT_CPU_FREQ_MHZ=240

#CONFIG_ESP_WIFI_RX_IRAM_OPT=y
#CONFIG_TWAI_ISR_IN_IRAM=y

#CONFIG_BT_CTRL_DFT_TX_POWER_LEVEL_P20=y
```
